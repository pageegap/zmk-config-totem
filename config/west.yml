## config/west.yml
```yaml
manifest:
  remotes:
    - name: zmkfirmware
      url-base: https://github.com/zmkfirmware
    - name: carrefinho
      url-base: https://github.com/carrefinho
  projects:
    - name: zmk
      remote: zmkfirmware
      revision: 147c340c6e8d377304acfdd64dc86cf83ebdfef2
      import: app/west.yml
    - name: prospector-zmk-module
      remote: carrefinho
      revision: main
  self:
    path: config
```
